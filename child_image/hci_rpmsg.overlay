/ {
	nrf_radio_fem: name_of_fem_node {
	   compatible = "nordic,nrf21540-fem";
	   tx-en-gpios = <&gpio0 30 GPIO_ACTIVE_HIGH>;
	   rx-en-gpios = <&gpio0 31 GPIO_ACTIVE_HIGH>;
	   pdn-gpios = <&gpio1 10 GPIO_ACTIVE_HIGH>;
	};
 };
